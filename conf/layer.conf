## conf/layer.conf
```bitbake
BBPATH .= ":${LAYERDIR}"

BBFILES += "${LAYERDIR}/recipes-*/*/*.bb \
            ${LAYERDIR}/recipes-*/*/*.bbappend"

BBFILE_COLLECTIONS += "jma-udoo"
BBFILE_PATTERN_jma-udoo := "^${LAYERDIR}/"
BBFILE_PRIORITY_jma-udoo = "6"
```

## conf/machine/udoo-quad.conf
```bitbake
#@TYPE: Machine
#@NAME: UDOO Quad
#@SOC: i.MX6Q
#@DESCRIPTION: Machine configuration for UDOO Quad

include conf/machine/include/imx-base.inc
include conf/machine/include/tune-cortexa9.inc

SOC_FAMILY = "mx6:mx6q:udoo"

KERNEL_IMAGETYPE = "uImage"
PREFERRED_PROVIDER_virtual/kernel ?= "linux-udoo"
PREFERRED_PROVIDER_u-boot = "u-boot-udoo"
PREFERRED_PROVIDER_virtual/bootloader ?= "u-boot-udoo"
UBOOT_MACHINE = "udoo_quad_config"
SERIAL_CONSOLE = "115200 ttymxc1"
MACHINE_FEATURES += " pci wifi"

MACHINE_FIRMWARE_append_mx6 = " \
	linux-firmware-ath6k \
	linux-firmware-ralink \
"

KERNEL_DEVICETREE = "imx6q-udoo.dtb"
```
